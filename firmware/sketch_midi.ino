#include <MIDIUSB.h>
#include <U8g2lib.h>
#include <Wire.h>

U8G2_SH1106_128X64_NONAME_F_HW_I2C screenA(U8G2_R0, U8X8_PIN_NONE); // Plugins
U8G2_SH1106_128X64_NONAME_F_HW_I2C screenB(U8G2_R0, U8X8_PIN_NONE); // Presets

// 'Bootsplash', 128x64px
const unsigned char epd_bitmap_Bootsplash [] PROGMEM = {
	0x00, 0x00, 0x00, 0x00, 0x00, 0x00, 0x00, 0x00, 0x00, 0x00, 0x00, 0x00, 0x00, 0x00, 0x00, 0x00, 
	0x00, 0x00, 0x00, 0x00, 0x10, 0x00, 0x00, 0x80, 0x3f, 0x00, 0x40, 0x08, 0x00, 0x00, 0x00, 0x00, 
	0x00, 0x00, 0x00, 0x00, 0x00, 0x01, 0x00, 0xe0, 0xff, 0x00, 0x00, 0x08, 0x00, 0x00, 0x00, 0x00, 
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	0x00, 0x00, 0x00, 0x00, 0x00, 0x00, 0x00, 0x00, 0x00, 0x00, 0x00, 0x00, 0x00, 0x00, 0x00, 0x00
};

// 'Skull', 20x20px
const unsigned char Skull [] PROGMEM = {
	0xe0, 0x7f, 0x00, 0x1c, 0x80, 0x03, 0x1c, 0x80, 0x03, 0x0c, 0x00, 0x03, 0x06, 0x00, 0x06, 0xf6, 
	0xf0, 0x06, 0xfd, 0xf9, 0x0b, 0xfd, 0xf9, 0x0b, 0xfd, 0xf9, 0x0b, 0xfd, 0xf9, 0x0b, 0xf1, 0xf0, 
	0x08, 0x07, 0x06, 0x0e, 0x0f, 0x06, 0x0f, 0x0e, 0x06, 0x07, 0x1c, 0x80, 0x03, 0x90, 0x99, 0x00, 
	0x90, 0x99, 0x00, 0xf0, 0xff, 0x00, 0xe0, 0x7f, 0x00, 0x00, 0x00, 0x00
};
//Feather
const unsigned char Feather [] PROGMEM = {
	0x00, 0xa0, 0x07, 0x00, 0xb0, 0x05, 0x00, 0xf2, 0x07, 0x00, 0x76, 0x06, 0x00, 0xb7, 0x01, 0x80, 
	0xd7, 0x07, 0xe0, 0xee, 0x03, 0xe0, 0xfe, 0x03, 0xe0, 0x36, 0x00, 0xe8, 0xfc, 0x01, 0xe8, 0x60, 
	0x00, 0x78, 0x3f, 0x00, 0xf8, 0x3f, 0x00, 0xb8, 0x1f, 0x00, 0xe8, 0x00, 0x00, 0xf4, 0x07, 0x00, 
	0x0c, 0x00, 0x00, 0x03, 0x00, 0x00, 0x02, 0x00, 0x00, 0x00, 0x00, 0x00
};
//Buttersfly
const unsigned char Butterfly [] PROGMEM = {
	0x00, 0x38, 0x00, 0x00, 0x38, 0x00, 0x00, 0x6c, 0x00, 0x40, 0xec, 0x00, 0x40, 0xdc, 0x00, 0x8c, 
	0xc4, 0x01, 0x10, 0x35, 0x01, 0x00, 0x95, 0x00, 0x00, 0xf7, 0x03, 0xf0, 0x3f, 0x06, 0x1e, 0x1d, 
	0x04, 0x77, 0x1c, 0x04, 0xd7, 0xf7, 0x06, 0x1e, 0x77, 0x07, 0x78, 0x73, 0x00, 0x60, 0x23, 0x00, 
	0xc0, 0x22, 0x00, 0x00, 0x3e, 0x00, 0x00, 0x3c, 0x00, 0x00, 0x00, 0x00
};

const unsigned char* pluginIcons[3] = {
  Skull,     // GOJIRA
  Feather,   // CORY WONG
  Butterfly  // PLINI
};

void showBootSplash() {
  // Screen A
  screenA.clearBuffer();
  screenA.drawXBMP(0, 0, 128, 64, epd_bitmap_Bootsplash);
  screenA.sendBuffer();

  // Screen B
  screenB.clearBuffer();
  screenB.drawXBMP(0, 0, 128, 64, epd_bitmap_Bootsplash);
  screenB.sendBuffer();

  delay(1500); // show for 1.5 seconds
}

  // Animation state
  unsigned long lastBlink = 0;
  bool blinkState = true;  // whether the ">" arrow is visible

  unsigned long lastVibrate = 0;
  bool vibrateActive = false;
  int vibrateOffset = 0;




// ============================================================
//  OLED DISPLAYS
// ============================================================

// Active selections
int activePlugin = 0;     // 0=Gojira, 1=Cory, 2=Plini
int currentPreset = -1;   // -1 = none yet selected

// Display names
const char* pluginNames[3] = {
  "GOJIRA",
  "CORY WONG",
  "PLINI"
};

const char* presetNames[3] = {
  "PRESET #1",
  "PRESET #2",
  "PRESET #3"
};


// ============================================================
//  EXPRESSION PEDAL (Wah)
// ============================================================
const int potPin = A0;
int potMin = 0;
int potMax = 234;
const int wahCC = 1;  // CC1 = Wah
int lastCC = -1;


// ============================================================
//  BUTTONS
// ============================================================
// Plugin switching buttons (4, 5, 6)
const int pluginButtons[3] = {4, 5, 6};
int lastPluginState[3] = {HIGH, HIGH, HIGH};
int pluginCC[3] = {20, 21, 22};   // CC20/21/22 for plugin switching

// Preset switching buttons (7, 8, 9)
const int presetButtons[3] = {7, 8, 9};
int lastPresetState[3] = {HIGH, HIGH, HIGH};
int presetPC[3] = {0, 1, 2};      // Preset Program Changes


// ============================================================
//  MIDI HELPERS
// ============================================================
void sendCC(byte cc, byte value) {
  midiEventPacket_t event = {0x0B, 0xB0, cc, value};
  MidiUSB.sendMIDI(event);
}

void sendPC(byte program) {
  midiEventPacket_t event = {0x0C, 0xC0, program, 0};
  MidiUSB.sendMIDI(event);
}


// ============================================================
//  DRAW UI ON SCREENS
// ============================================================
void updateScreens() {

  // ----- LEFT SCREEN (Plugins) -----
  screenB.clearBuffer();
  screenB.setFont(u8g2_font_7x13_tr);
  screenB.drawFrame(0, 0, 128, 64);

  // Icon vibrate offset
  int xOffset = vibrateActive ? vibrateOffset : 0;

  screenB.drawXBMP(108 + xOffset, 0, 20, 20, pluginIcons[activePlugin]);
  screenB.drawStr(5, 13, "PLUGINS:");

  for (int i = 0; i < 3; i++) {
    int y = 28 + i * 14;
    const char* text = pluginNames[i];

    int textWidth = screenB.getStrWidth(text);
    int x = (128 - textWidth) / 2;

    if (i == activePlugin && blinkState) {
      screenB.drawStr(2, y - 2, ">");  // Blinking arrow
    }

    screenB.drawStr(x, y, text);
  }

  screenB.sendBuffer();


  // ----- RIGHT SCREEN (Presets) -----
  screenA.clearBuffer();
  screenA.setFont(u8g2_font_7x13_tr);
  screenA.drawFrame(0, 0, 128, 64);
  screenA.drawXBMP(108 + xOffset, 0, 20, 20, pluginIcons[activePlugin]);

  screenA.drawStr(5, 13, "PRESETS:");

  for (int i = 0; i < 3; i++) {
    int y = 28 + i * 14;
    const char* text = presetNames[i];

    int textWidth = screenA.getStrWidth(text);
    int x = (128 - textWidth) / 2;

    if (i == currentPreset && blinkState) {
      screenA.drawStr(2, y - 2, ">");  // blinking arrow
    }

    screenA.drawStr(x, y, text);
  }

  screenA.sendBuffer();
}



// ============================================================
//  SETUP
// ============================================================
void setup() {
  // Assign correct I2C addresses BEFORE ANY DRAWING
  screenA.setI2CAddress(0x3C * 2); // left screen
  screenB.setI2CAddress(0x3D * 2); // right screen

  screenA.begin();
  screenB.begin();

  showBootSplash(); 


  // Buttons
  for (int i = 0; i < 3; i++) {
    pinMode(pluginButtons[i], INPUT_PULLUP);
    pinMode(presetButtons[i], INPUT_PULLUP);
  }

  updateScreens();  // Draw initial UI
}


// ============================================================
//  MAIN LOOP
// ============================================================
void loop() {
  // ---------------- BLINKING ARROW ----------------
  if (millis() - lastBlink > 350) {
    blinkState = !blinkState;
    lastBlink = millis();
    updateScreens();
  }

  // ---------------- ICON VIBRATION ----------------
  if (vibrateActive && millis() - lastVibrate > 20) {
    vibrateOffset = (vibrateOffset == 1 ? -1 : 1); // jitter
    lastVibrate = millis();
    updateScreens();
  }


  // ---------------- EXPRESSION PEDAL ----------------
  int raw = analogRead(potPin);
  raw = constrain(raw, potMin, potMax);
  int ccValue = map(raw, potMin, potMax, 127, 0);

  if (abs(ccValue - lastCC) > 1) {
    sendCC(wahCC, ccValue);
    lastCC = ccValue;
  }


  // ---------------- PLUGIN SWITCHING BUTTONS (4-6) ----------------
  for (int i = 0; i < 3; i++) {
    int state = digitalRead(pluginButtons[i]);

    if (state == LOW && lastPluginState[i] == HIGH) {
      activePlugin = i;
      sendCC(pluginCC[i], 127);
      updateScreens();
    }

    lastPluginState[i] = state;
  }


  // ---------------- PRESET SWITCHING BUTTONS (7-9) ----------------
  for (int i = 0; i < 3; i++) {
    int state = digitalRead(presetButtons[i]);

    if (state == LOW && lastPresetState[i] == HIGH) {
      sendPC(presetPC[i]);
      currentPreset = i;
      updateScreens();
    }

    lastPresetState[i] = state;
  }

  MidiUSB.flush();
  delay(3);
}
